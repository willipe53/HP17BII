// 'barrier' 12 5x5 squares
//     0-11: solid
//    12-24: broken
const unsigned char barrier [24][5] PROGMEM = {
  {0x08, 0x18, 0x38, 0x78, 0xf8},
  {0xf8, 0xf8, 0xf8, 0xf8, 0xf8},
  {0xf8, 0xf8, 0xf8, 0xf8, 0xf8},
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  {0xf8, 0xa8, 0xa8, 0x20, 0x30}
};

// 'gun', 10x8px
const unsigned char gun [] PROGMEM = {
  0x0c, 0x00, 0x0c, 0x00, 0x0c, 0x00, 0x7f, 0x80, 0xff, 0xc0, 0xff, 0xc0, 0xff, 0xc0, 0xff, 0xc0
};

// 'explode', 10x10px
const unsigned char explode [] PROGMEM = {
  0x01, 0x00, 0xa2, 0x40, 0x54, 0x80, 0x21, 0x00, 0x02, 0x40, 0x80, 0x00, 0x21, 0x00, 0x40, 0x80, 
  0x94, 0x40, 0x22, 0x00
};

// 'invaders 1a,1b,2a,2b,3a,3b', 10x10px
const unsigned char invader[6][20] PROGMEM = {
  {0x3f, 0x00, 0x7f, 0x80, 0xff, 0xc0, 0xff, 0xc0, 0xde, 0xc0, 0xff, 0xc0, 0x21, 0x00, 0x4c, 0x80, 0x4c, 0x80, 0x21, 0x00},
  {0x3f, 0x00, 0x7f, 0x80, 0xff, 0xc0, 0xff, 0xc0, 0xde, 0xc0, 0xff, 0xc0, 0x21, 0x00, 0x4c, 0x80, 0x4c, 0x80, 0x80, 0x40},
  {0x40, 0x80, 0xa1, 0x40, 0xb3, 0x40, 0xff, 0xc0, 0xed, 0xc0, 0x7f, 0x80, 0x3f, 0x00, 0x21, 0x00, 0x33, 0x00, 0x12, 0x00},
  {0x40, 0x80, 0x21, 0x00, 0x33, 0x00, 0x7f, 0x80, 0x6d, 0x80, 0xff, 0xc0, 0xbf, 0x40, 0xa1, 0x40, 0xb3, 0x40, 0x12, 0x00},
  {0x0c, 0x00, 0x1e, 0x00, 0x3f, 0x00, 0x7f, 0x80, 0xed, 0xc0, 0x7f, 0x80, 0x5e, 0x80, 0x4c, 0x80, 0x80, 0x40, 0x00, 0x00},
  {0x0c, 0x00, 0x1e, 0x00, 0x3f, 0x00, 0x7f, 0x80, 0xed, 0xc0, 0x7f, 0x80, 0x5e, 0x80, 0x4c, 0x80, 0x21, 0x00, 0x00, 0x00}
};
// 'controls', 92x99px
const unsigned char controls [] PROGMEM = {
  0x00, 0x00, 0x00, 0x00, 0x00, 0x00, 0x00, 0x00, 0x00, 0x00, 0x00, 0x00, 0x00, 0x3f, 0x00, 0x00, 
  0x00, 0x00, 0x00, 0x03, 0x80, 0x00, 0x00, 0x00, 0x00, 0x7f, 0x80, 0x00, 0x00, 0x80, 0x00, 0x03, 
  0x80, 0x00, 0x00, 0x00, 0x00, 0xf5, 0x00, 0x00, 0x01, 0xc0, 0x00, 0x03, 0x80, 0x00, 0x00, 0x00, 
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  0xff, 0xff, 0xff, 0xf0
};
// 'scoreboard', 92x99px
const unsigned char scoreBoard [] PROGMEM = {
  0x00, 0x7c, 0x00, 0x00, 0x00, 0x00, 0x00, 0x00, 0x00, 0x00, 0x00, 0x00, 0x00, 0xfe, 0x00, 0x00, 
  0x00, 0x00, 0x00, 0x00, 0x00, 0x00, 0x00, 0x00, 0x01, 0xd4, 0x00, 0x00, 0x00, 0x00, 0x00, 0x00, 
  0x00, 0x00, 0x00, 0x00, 0x01, 0xc0, 0x00, 0x00, 0x00, 0x00, 0x00, 0x00, 0x00, 0x00, 0x00, 0x00, 
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  0xff, 0xff, 0xff, 0xf0
};

void startGame(char key) {
  gameStarted = true;
  gunY = startY+97;
  alienY = startY+24;
  barrierY = startY+70;
  alienX = 100;
  gameScore = 0;
  gameStartTime = millis();
  for (int i=0; i<4; i++) {
    for (int j=0; j<12; j++) {
      barrierState[i][j] = 2; //solid
    }
  }
}

void gameOver(char key) {
  gameStarted = false;
  playerDeath(0);
}

bool bulletFlying() {
  if (bulletY < 0) return false;
  if (bulletY < startY) return false;
  return true;
}

bool bombDropping() {
  if (bombY < 0) return false;
  if (bombY < startY) return false;
  return true;
}

bool bulletInsideOf(int x, int y, int w, int h) {
  if (bulletX < x) return false;
  if (bulletX > x+w) return false;
  if (bulletY < y) return false;
  if (bulletY > y+h) return false;
  return true;
}

bool bombInsideOf(int x, int y, int w, int h) {
  if (bombX < x) return false;
  if (bombX > x+w) return false;
  if (bombY < y) return false;
  if (bombY > y+h) return false;
  return true;
}

void drawPlayArea() {
  gameCanvas.fillScreen(WHITE);

  //bullet 
  if (bulletFlying()) { 
    gameCanvas.fillRect(bulletX, bulletY, 2, 4, BLACK);
    bulletY-=4;
  }

  //bomb
  if (bombDropping()) {
    gameCanvas.fillRect(bombX, bombY, 2, 4, BLACK);
    bombY+=4;    
  }
  if (bombInsideOf(gunX, gunY, 10, 8)) gameOver(0);
  
  //aliens
  if (gameStarted) {
    for (int r=0; r<3; r++) {
      for (int a=0; a<10; a++) {
        int x = alienX+(a*15);
        int y = alienY-(r*20);
        int idx = r*2;
        if (aliensOpen) idx++;
        if (deadAliens[(r*10)+a]) {
          gameCanvas.fillRect(x, y, 10, 10, WHITE);
        } else if (bulletInsideOf(x, y, 10, 10)) {
          gameCanvas.drawBitmap(x, y, explode, 10, 10, BLACK);  
          killAlien((r*10)+a);
        } else {
          gameCanvas.drawBitmap(x, y, invader[idx], 10, 10, BLACK); 
        }
      }
    }
  }
  
  //barriers
  for (int i=0; i<4; i++) {
    for (int j=0; j<12; j++) {
      int offsetX = (j % 4) * 5;
      int offsetY = 10;
      if (j<8) offsetY = 5;
      if (j<4) offsetY = 0;
      int x = barrierX[i] + offsetX;
      int y = barrierY + offsetY;
      int bs = getBarrierState(i,j,x,y);
      if (!gameStarted) {
        gameCanvas.drawBitmap(x, y, barrier[j], 5, 5, BLACK); 
      } else if (bs == 0) {
        gameCanvas.fillRect(x, y, 5, 5, WHITE);
      } else if (bs == 1) {
        gameCanvas.drawBitmap(x, y, barrier[j+12], 5, 5, BLACK);        
      } else {
        gameCanvas.drawBitmap(x, y, barrier[j], 5, 5, BLACK);                
      }
    }
  }
  
  //gun
  gameCanvas.drawBitmap(gunX, gunY, gun, 10, 8, BLACK);

  //info bars
  gameCanvas.drawBitmap(5, startY+5, controls, 92, 99, BLACK);
  gameCanvas.drawBitmap(400-5-92, startY+5, scoreBoard, 92, 99, BLACK);
  gameCanvas.drawBitmap(15, startY+85, gun, 10, 8, BLACK);
  gameCanvas.drawBitmap(30, startY+85, gun, 10, 8, BLACK);
  gameCanvas.drawBitmap(45, startY+85, gun, 10, 8, BLACK);
  gameCanvas.setTextColor(BLACK);
  gameCanvas.setTextSize(3);
  gameCanvas.setTextWrap(false);
  gameCanvas.fillRect(310, startY+40, 75, 50, WHITE);  
  gameCanvas.setCursor(310,startY+40);
  gameCanvas.print(gameScore);

  //game over
  if (!gameStarted) {
    gameCanvas.setTextColor(WHITE, BLACK);
    gameCanvas.setCursor(120,startY+40);
    gameCanvas.print("Game Over");
    gameCanvas.setCursor(90,gunY);
    gameCanvas.setTextSize(2);
    gameCanvas.print("Press CLR to start");
  }
 
  //copy to screen
  display.drawBitmap(0, 0, gameCanvas.getBuffer(), 400, 240, WHITE, BLACK   ); 
  display.refresh();
}

int getBarrierState(int i, int j, int x, int y) {
  if (bulletInsideOf(x, y, 5, 5)) {
    barrierState[i][j]--; //0=none, 1=broken, 2=solid
    if (barrierState[i][j] > 0) bulletX = bulletY = -1;
    else barrierState[i][j] = 0;
  }
  if (bombInsideOf(x, y, 5, 5)) {
    barrierState[i][j]--;
    if (barrierState[i][j] > 0) bombX = bombY = -1;
    else barrierState[i][j] = 0;
  }
  return barrierState[i][j];
}

void killAlien(int idx) {
  invaderDeath(0);
  gameScore += 100;
  deadAliens[idx] = true;
  bulletX = bulletY = -1;
  for (int i=0; i<numFrontLineAliens; i++) {
    if (frontLineAliens[i] == idx) {
      frontLineAliens[i] -= 100; //choose the guy in the next row up
      if (frontLineAliens[i] < 0) { //if there is no guy in the next row up
        numFrontLineAliens--;
        for (int j=i; j<numFrontLineAliens; j++) {
          frontLineAliens[j] = frontLineAliens[j+1];
        }
      }
      return;
    }
  }
}

void moveGun(char key) {
  if (!gameStarted) return;
  if (key == '7') gunX-=10;
  else gunX+=10;
  if (gunX < 95) gunX = 95;
  if (gunX > 293) gunX = 393;
}

void fireGun(char key) {
  if (!gameStarted) return;
  updateSeed();
  playPhaser();
  bulletX = gunX + 4;
  bulletY = gunY - 4; 
}

void dropBomb(char key) {
  if (!gameStarted) return;
  randomSeed(seed);
  int bomber = random(0,numFrontLineAliens);
  int r = 2;
  if (bomber<20) r = 1;
  if (bomber<10) r = 0;
  int a = bomber - (r*10);
  int x = alienX+(a*15);
  int y = alienY-(r*20);
  bombX = x + 4;
  bombY = y + 4; 
}

unsigned long scheduleTone(int freq, int dur, unsigned long startTime) {
  static int idx = 0;
  unsigned long endTime;
  toneStart[idx] = startTime;
  toneFreq[idx] = freq;
  endTime = toneEnd[idx] = toneStart[idx] + dur; 
  idx++;
  if (idx > 100) idx = 0;
  return endTime;
}

int toneScheduledFor(unsigned long ms) {
  for (int i=0; i<100; i++) {
    if ((toneStart[i] <= ms) && (toneEnd[i] >= ms)) {
      return i; 
    }
  }
  return -1;
}

void invaderDeath(char key) {
  //100,100,110,100,60,400,
  unsigned long endTime = millis();
  endTime = scheduleTone(100, 100, endTime);
  endTime = scheduleTone(110, 100, endTime);
  endTime = scheduleTone(60, 400, endTime);
}

void playerDeath(char key) {
  //140,20,130,20,120,20,110,20,100,20,90,20,80,20,70,20,60,1000,
  int freq = 140;
  unsigned long endTime = millis();
  for (int i=0; i<8; i++) {
    endTime = scheduleTone(freq, 100, endTime);
    freq -= 10;
  }
  endTime = scheduleTone(freq, 1000, endTime);
}

void playPhaser() {
  //2600,20,2500,20,2400,20,2300,20,2200,20,2100,20,2000,20,1900,20,1800,20,1700,200,
  int freq = 1700;
  unsigned long endTime = millis();
  for (int i=0; i<9; i++) {
    endTime = scheduleTone(freq, 100, endTime);
    freq += 100;
  }
  endTime = scheduleTone(freq, 200, endTime);
}
