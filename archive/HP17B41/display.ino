//used: http://javl.github.io/image2cpp/

// 'hplogo', 400x100px
const unsigned char hplogo [] PROGMEM = {
  0x00, 0x00, 0x00, 0x00, 0x00, 0x00, 0x00, 0x00, 0x00, 0x00, 0x00, 0x00, 0x00, 0x00, 0x00, 0x00, 
  0x00, 0x00, 0x00, 0x00, 0x00, 0x00, 0x00, 0x00, 0x00, 0x00, 0x00, 0x00, 0x00, 0x00, 0x00, 0x00, 
  0x00, 0x00, 0x00, 0x00, 0x00, 0x00, 0x00, 0x00, 0x00, 0x00, 0x00, 0x00, 0x00, 0x00, 0x00, 0x00, 
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  0x00, 0x00, 0x00, 0x00, 0x00, 0x00, 0x00, 0x00
};

void initDisplay() {
  display.begin();
  display.clearDisplay();
  drawLogo(false);
  display.refresh();
  delay(100);    
  redrawDisplay();
}

void drawLogo(bool inverted) {
  int fgColor = (inverted) ? WHITE : BLACK;
  int bgColor = (inverted) ? BLACK : WHITE;
  display.fillRect(0, startY, display.width(), MAIN_H, bgColor);
  display.drawBitmap(0, startY, hplogo, display.width(), MAIN_H, fgColor);
  drawButtonBar();
  display.refresh();
}

void drawButtonBar() {
  String softButtons[] = {"CALC","PIANO","LOGO","GAME","BACK","RESET"};
  int textSize = 2;
  int marginW = 2;
  int gutterW = 1;
  int buttonW = (display.width()-(gutterW*5))/6;
  display.setTextColor(WHITE);
  display.setTextSize(textSize);
  display.setTextWrap(false);
  for (int i=0; i<6; i++) {
    int strW = (softButtons[i].length()*12)-2;
    int buttonX = marginW+(i*(buttonW+gutterW));
    int textX = buttonX + ((buttonW-strW)/2);
    display.fillRect(buttonX, startY+MAIN_H+1, buttonW, (textSize*7)+(2*gutterW), BLACK);  
    display.setCursor(textX,startY+MAIN_H+1+gutterW);
    display.print(softButtons[i]);
  }
}

void toggleCommasInDisplay(char c) {
  int commaLoc = registers[0].indexOf(',');
  if (commaLoc > 0) {
    Serial.printf("Making %s ugly\n", registers[0].c_str());    
    while (commaLoc > 0) {
      registers[0].remove(commaLoc,1);
      commaLoc = registers[0].indexOf(',');
    }
  } else {
    Serial.printf("Making %s pretty\n", registers[0].c_str());    
    int dotLoc = registers[0].indexOf('.');
    if (dotLoc < 0) dotLoc = registers[0].length();
    int mainLength = dotLoc;
    int commasNeeded = (int)mainLength/3;
    if (mainLength <= 3 || commasNeeded < 1) return;
    int tripStart = dotLoc-3;
    String temp = registers[0].substring(dotLoc);
    if (commasNeeded<1) return;
    for (int i=0; i<commasNeeded; i++) {
      String trip = registers[0].substring(tripStart,tripStart+3);
      if (i == 0) temp = trip + temp;
      else temp = trip + "," + temp;
      tripStart -= 3;
    }
    String frontPart = registers[0].substring(0,tripStart+3);
    if (frontPart.length() > 0) registers[0] = frontPart + "," + temp;
    else registers[0] = temp;
  }
  redrawDisplay();
}

void drawShiftIndicator(bool state) {
  int color = (state) ? BLACK : WHITE;
  display.fillTriangle(10, startY+MAIN_H-19,
                        2, startY+MAIN_H-7,
                       18, startY+MAIN_H-7, color);
  display.fillRect(8, startY+MAIN_H-7,  4, 3, color);
  display.fillRect(2,  startY+MAIN_H-4, 10, 3, color);
  display.refresh();
  Serial.printf("Drawing shift indicator:%d\n", state);
}

void redrawDisplay() {
  display.clearDisplay();
  if (currentMode == PIANO_MODE) drawPiano();
  else if (currentMode == LOGO_MODE) drawLogo(true);
  else if (currentMode == GAME_MODE) drawPlayArea();
  else repaintRegisters();
  display.refresh();
}

void saveScreenPosition(char key) {
  Serial.printf("Saved screen position of %d to flash memory\n", startY);
  //if (startY != start_y_flash.read())
  start_y_flash.write(startY);
}

void shiftScreenPosition(char key) {
  if (key == 'U') startY--;
  if (key == 'D') startY++;  
  Serial.printf("startY: %d\n", startY);
  redrawDisplay();
}

void repaintRegisters() {
  int textSize = 3;
  display.setTextSize(textSize);
  display.setTextColor(BLACK);
  display.setTextWrap(false);
  //if (registers[0].length() == 0) registers[0] = "Calculator ready";
  for (int i=0; i<VISIBLE_ROWS; i++) {
    String s = registers[i];
    display.setCursor(display.width()-(s.length()*textSize*6),startY+MAIN_H-(24 * (i+1)));
    display.println(s);
  }
  drawButtonBar();
}
